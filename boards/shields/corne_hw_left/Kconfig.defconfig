## boards/shields/corne_hw_left/Kconfig.defconfig
```kconfig
if SHIELD_CORNE_HW_LEFT

config ZMK_KEYBOARD_NAME
    default "Corne HW"

config ZMK_SPLIT
    default y

config ZMK_SPLIT_BLE
    default y

config ZMK_SPLIT_BLE_ROLE_CENTRAL
    default y

config ZMK_USB
    default y

endif
```

## boards/shields/corne_hw_right/Kconfig.defconfig
```kconfig
if SHIELD_CORNE_HW_RIGHT

config ZMK_KEYBOARD_NAME
    default "Corne HW"

config ZMK_SPLIT
    default y

config ZMK_SPLIT_BLE
    default y

config ZMK_SPLIT_BLE_ROLE_PERIPHERAL
    default y

config ZMK_USB
    default y

endif
```
