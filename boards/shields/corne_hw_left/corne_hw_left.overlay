#include <dt-bindings/zmk/matrix_transform.h>
#include <zephyr/dt-bindings/pinctrl/nrf-pinctrl.h>
#include <dt-bindings/i2c/i2c.h>

/ {
    chosen { 
        zmk,kscan = &kscan0;
        zmk,matrix-transform = &default;
    };

    kscan0: kscan {
        compatible = "zmk,kscan-gpio-matrix";
        label = "KSCAN_LEFT";
        row-gpios = <&gpio1 0  (GPIO_ACTIVE_HIGH | GPIO_PULL_DOWN)>,
                    <&gpio0 11 (GPIO_ACTIVE_HIGH | GPIO_PULL_DOWN)>,
                    <&gpio1 4  (GPIO_ACTIVE_HIGH | GPIO_PULL_DOWN)>,
                    <&gpio1 6  (GPIO_ACTIVE_HIGH | GPIO_PULL_DOWN)>;
        col-gpios = <&gpio0 2  GPIO_ACTIVE_HIGH>,
                    <&gpio1 15 GPIO_ACTIVE_HIGH>,
                    <&gpio1 13 GPIO_ACTIVE_HIGH>,
                    <&gpio1 11 GPIO_ACTIVE_HIGH>,
                    <&gpio0 10 GPIO_ACTIVE_HIGH>,
                    <&gpio0 9  GPIO_ACTIVE_HIGH>;
        diode-direction = "col2row";
        debounce-press-ms = <5>;
        debounce-release-ms = <5>;
        wakeup-source;
    };

    default: matrix_transform {
        compatible = "zmk,matrix-transform";
        columns = <6>;
        rows = <4>;
        map = <0 1 2 3 4 5   12 13 14 15 16 17   24 25 26 27 28 29   36 37 38 39 40 41>;
    };
};


